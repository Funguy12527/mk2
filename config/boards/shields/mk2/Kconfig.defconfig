## config/boards/shields/mk2/Kconfig.defconfig
```kconfig
if SHIELD_MK2_LEFT

# Name must be less than 16 characters long!
config ZMK_KEYBOARD_NAME
    default "mk2"

config ZMK_SPLIT_ROLE_CENTRAL
    default y

endif

if SHIELD_MK2_LEFT || SHIELD_MK2_RIGHT

config ZMK_SPLIT
    default y

endif
```

## config/boards/shields/mk2/Kconfig.shield
```kconfig
config SHIELD_MK2_LEFT
    def_bool $(shields_list_contains,mk2_left)


config SHIELD_MK2_RIGHT
    def_bool $(shields_list_contains,mk2_right)
```
